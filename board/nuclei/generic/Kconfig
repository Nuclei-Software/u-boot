## board/nuclei/generic/Kconfig
```kconfig
if TARGET_NUCLEI_GENERIC_SOC

config SYS_BOARD
	default "generic"

config SYS_VENDOR
	default "nuclei"

config SYS_CPU
	default "generic"

config SYS_CONFIG_NAME
	default "nuclei-generic"

config SYS_TEXT_BASE
	default 0xA0000000 if !RISCV_SMODE
	default 0xA0200000 if RISCV_SMODE

config BOARD_SPECIFIC_OPTIONS # dummy
	def_bool y
	select GENERIC_RISCV
	imply CMD_EXT2
	imply CMD_EXT4
	imply CMD_FAT
	imply CMD_FS_GENERIC
	imply CMD_SF
	imply DOS_PARTITION
	imply NUCLEI_SERIAL
	imply SPI
	imply NUCLEI_SPI
	imply SPI_FLASH
	imply SPI_FLASH_ISSI
	imply MMC
	imply MMC_SPI
	imply MMC_BROKEN_CD
	imply CMD_MMC
	imply SMP

endif
```

## drivers/clk/nuclei/Kconfig
```kconfig
config CLK_NUCLEI
	bool "Enable clock driver support for NUCLEI SOC"
	depends on CLK
	default y
	help
	  This clock driver adds support for RCC clock management
	  for NUCLEI SoCs.
```

## drivers/crypto/nuclei/Kconfig
```kconfig
config NUCLEI_HSM_AES
	bool "Enable Nuclei HSM AES HW accelerator"
	default n
	select NUCLEI_HSM_MAILBOX
	help
	  This option enables support of Nuclei HSM HW SHA accelerator.
	  It supports SHA1 and SHA256 hashing algorithms.

config NUCLEI_HSM_SHA
	bool "Enable Nuclei HSM SHA HW accelerator"
	default n
	select NUCLEI_HSM_MAILBOX
	help
	  This option enables support of Nuclei HSM HW SHA accelerator.
	  It supports SHA1 and SHA256 hashing algorithms.

config NUCLEI_HSM_RSA
	bool "Enable Nuclei HSM RSA HW accelerator"
	default n
	select NUCLEI_HSM_MAILBOX
	help
	  This option enables support of Nuclei HSM HW RSA accelerator.

config NUCLEI_HSM_MAILBOX
	bool "Support Nuclei HSM MAILBOX"
	default n
	help
	  This option enables support of Nuclei HSM Mailbox.
```
