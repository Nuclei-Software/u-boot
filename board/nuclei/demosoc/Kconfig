## board/nuclei/demosoc/Kconfig
```kconfig
if TARGET_NUCLEI_DEMOSOC

config SYS_BOARD
	default "demosoc"

config SYS_VENDOR
	default "nuclei"

config SYS_CPU
	default "generic"

config SYS_CONFIG_NAME
	default "nuclei-demosoc"

config SYS_TEXT_BASE
	default 0xA0000000 if !RISCV_SMODE
	default 0xA0200000 if RISCV_SMODE

config BOARD_SPECIFIC_OPTIONS # dummy
	def_bool y
	select GENERIC_RISCV
	imply CMD_EXT2
	imply CMD_EXT4
	imply CMD_FAT
	imply CMD_FS_GENERIC
	imply CMD_SF
	imply DOS_PARTITION
	imply NUCLEI_SERIAL
	imply SPI
	imply NUCLEI_SPI
	imply SPI_FLASH
	imply SPI_FLASH_ISSI
	imply MMC
	imply MMC_SPI
	imply MMC_BROKEN_CD
	imply CMD_MMC
	imply DM_GPIO
	imply NUCLEI_GPIO
	imply CMD_GPIO
	imply SMP

endif
```
